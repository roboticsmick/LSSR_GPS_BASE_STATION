/*
  This code for for the receiver
  Connections
  Module      Teensy/LORA
  M0          10
  M1          9
  Rx          # (This is the MCU Tx line)
  Tx          # (MCU Rx line)
  Aux         6
  Vcc         5V
  Gnd         Gnd

  Module      Sparfun ZOE-M8Q
  SDA         # 
  SCL         # 
  Vcc         3V3
  Gnd         Gnd
*/

#include "EBYTE.h"
#include <Wire.h>
#include <Adafruit_GFX.h>
#include <Adafruit_SSD1306.h>
#include <Adafruit_I2CDevice.h>
#include <elapsedMillis.h>
#include <Bounce2.h>
#include <SoftwareSerial.h>

// Connect to any of the Teensy Serial ports
#define ESerial Serial2
#define gpsPort Serial5

#define SCREEN_WIDTH 128    // OLED display width, in pixels
#define SCREEN_HEIGHT 64    // OLED display height, in pixels
#define I2C_COMP_ADDRESS 0x1E // 0x1E 0011110b, I2C 7bit address of HMC5883

#define PIN_M0 10
#define PIN_M1 9
#define PIN_AX 6
int LED0 = 0;          // LED0
int LED1 = 1;         // LED1
int LEFTBUTTON = 29;
int UPBUTTON = 27;
int RIGHTBUTTON = 28;
int DOWNBUTTON = 30;
int MIDDLEBUTTON = 31;
int buttonDebounce = 5; // Debounce time

// Declaration for an SSD1306 display connected to I2C (SDA, SCL pins)
#define OLED_RESET 4 // Reset pin # (or -1 if sharing Arduino reset pin)
Adafruit_SSD1306 display(SCREEN_WIDTH, SCREEN_HEIGHT, &Wire2, OLED_RESET);

// GPS packet
struct DATA {
  long lat;
  long lon;
  long alt;
  byte SIV;
};


DATA GPSData;
int Chan;
unsigned long Last;

// Button debounce initialise
Bounce leftButton = Bounce();
Bounce upButton = Bounce();
Bounce rightButton = Bounce();
Bounce downButton = Bounce();
Bounce middleButton = Bounce();

// create the transceiver object, passing in the serial and pins
EBYTE Transceiver(&ESerial, PIN_M0, PIN_M1, PIN_AX);

// Logo
#define LOGO_HEIGHT 64
#define LOGO_WIDTH 128
static const unsigned char PROGMEM logo_bmp[] =
  {
    0xff, 0xff, 0xff, 0xff, 0xff, 0xff, 0xff, 0xff, 0xff, 0xff, 0xff, 0xff, 0xff, 0xff, 0xff, 0xff,
    0xff, 0xff, 0xff, 0xff, 0xff, 0xff, 0xff, 0xff, 0xff, 0xff, 0xff, 0xff, 0xff, 0xff, 0xff, 0xff,
    0xff, 0xff, 0xff, 0xff, 0xff, 0xff, 0xff, 0xff, 0xff, 0xff, 0xff, 0xff, 0xff, 0xff, 0xff, 0xff,
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    0xff, 0xff, 0xff, 0xff, 0xff, 0xff, 0xff, 0xff, 0xff, 0xff, 0xff, 0xff, 0xff, 0xff, 0xff, 0xff
};


void drawlogo(void)
{
  display.clearDisplay();
  display.drawBitmap(
    (display.width() - LOGO_WIDTH) / 2,
    (display.height() - LOGO_HEIGHT) / 2,
    logo_bmp, LOGO_WIDTH, LOGO_HEIGHT, 1);
  display.display();
  delay(1000);
  // Invert and restore display, pausing in-between
  display.invertDisplay(true);
  delay(1000);
  display.invertDisplay(false);
  delay(1000);
  display.clearDisplay();
}

void printtext(void)
{
  display.clearDisplay();

  display.setTextSize(1);        // Normal 1:1 pixel scale
  display.setTextColor(SSD1306_WHITE); // Draw white text
  display.setCursor(0, 0);       // Start at top-left corner
  display.cp437(true);         // Use full 256 char 'Code Page 437' font

  display.print("Lat: ");
  display.print(GPSData.lat / 10000000., 7);
  display.print("\n");
  display.print("Lon: ");
  display.print(GPSData.lon / 10000000., 7);
  display.print("\n");
  display.print("Alt: ");
  display.print(GPSData.alt / 1000., 2);
  display.print("\n");
  display.print("SIV: ");
  display.print(GPSData.SIV);
  
  display.display();
}


void setup() {

  Serial.begin(9600);

  // wait for the serial to connect
//  while (!Serial) {}

  // start the transceiver serial port--i have yet to get a different
  // baud rate to work--data sheet says to keep on 9600

  ESerial.begin(9600);

  // this init will set the pinModes for you
  Transceiver.init();

  // SSD1306_SWITCHCAPVCC = generate display voltage from 3.3V internally
  if (!display.begin(SSD1306_SWITCHCAPVCC, 0x3C))
  { // Address 0x3D for 128x64
    Serial.println(F("SSD1306 allocation failed"));
    for (;;)
      ; // Don't proceed, loop forever
  }
  display.setRotation(2); // Rotates screen 180 degrees
  drawlogo();       // Draw LSR Logo
  delay(2000);
  display.clearDisplay(); // Clear the buffer

  pinMode(LED0, OUTPUT); // Set 0 as LED output
  pinMode(LED1, OUTPUT); // Set 1 as LED output

  // Button Setup and Debounce
  pinMode(LEFTBUTTON, INPUT); // Left button
  leftButton.attach(LEFTBUTTON);
  leftButton.interval(buttonDebounce);

  pinMode(UPBUTTON, INPUT); // Left button
  upButton.attach(UPBUTTON);
  upButton.interval(buttonDebounce);

  pinMode(RIGHTBUTTON, INPUT); // Left button
  rightButton.attach(RIGHTBUTTON);
  rightButton.interval(buttonDebounce);

  pinMode(DOWNBUTTON, INPUT); // Left button
  downButton.attach(DOWNBUTTON);
  downButton.interval(buttonDebounce);

  pinMode(MIDDLEBUTTON, INPUT); // Left button
  middleButton.attach(MIDDLEBUTTON);
  middleButton.interval(buttonDebounce);

}

void loop() {
  
  // If the transceiver serial is available, process incoming data
  // you can also use ESerial.available()
  if (Transceiver.available()) {

    digitalWrite(LED0, HIGH);

    // Read transciever data
    Transceiver.GetStruct(&GPSData, sizeof(GPSData));

    if (GPSData.SIV >= 3) {
      digitalWrite(LED1, HIGH);
    } 
    else {
      digitalWrite(LED1, LOW);
    }

    // Convert to googlemaps coordinates 
    Serial.print(GPSData.lat / 10000000., 7);
    Serial.print(F(", "));
    Serial.print(GPSData.lon / 10000000., 7);
    Serial.print(F(", "));
    Serial.print(GPSData.alt / 1000., 2);
    Serial.print(F(", "));
    Serial.print(GPSData.SIV);
    Serial.println();
  
    printtext();
    
    // if you got data, update the checker
    Last = millis();
  }
  else {
    // if the time checker is over some prescribed amount
    // let the user know there is no incoming data
    if ((millis() - Last) > 200) {
      digitalWrite(LED0, LOW);
      Last = millis();
    }
  }
}
